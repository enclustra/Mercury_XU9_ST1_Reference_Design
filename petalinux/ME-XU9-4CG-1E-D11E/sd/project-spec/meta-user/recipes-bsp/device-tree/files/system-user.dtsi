/include/ "system-conf.dtsi"
/ {
	model = "Enclustra ME-XU9-4CG-1E-D11E SOM";
};
#include "zynqmp_enclustra_common.dtsi"
#include "zynqmp_enclustra_mercury_xu9.dtsi"
#include "zynqmp_enclustra_mercury_st1.dtsi"
