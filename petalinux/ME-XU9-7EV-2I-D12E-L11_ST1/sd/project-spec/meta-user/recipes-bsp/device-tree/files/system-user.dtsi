/include/ "system-conf.dtsi"
/ {
	model = "Enclustra ME-XU9-7EV-2I-D12E-L11 SOM";
};
#include "zynqmp_enclustra_common.dtsi"
#include "zynqmp_enclustra_mercury_st1.dtsi"
#include "zynqmp_enclustra_mercury_xu9.dtsi"
